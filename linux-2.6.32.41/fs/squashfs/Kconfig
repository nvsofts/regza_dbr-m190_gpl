## linux-2.6.32.41/fs/squashfs/Kconfig
```kconfig
config SQUASHFS
	tristate "SquashFS 4.0 - Squashed file system support"
	depends on BLOCK
	select ZLIB_INFLATE
	help
	  Saying Y here includes support for SquashFS 4.0 (a Compressed
	  Read-Only File System).  Squashfs is a highly compressed read-only
	  filesystem for Linux.  It uses zlib compression to compress both
	  files, inodes and directories.  Inodes in the system are very small
	  and all blocks are packed to minimise data overhead. Block sizes
	  greater than 4K are supported up to a maximum of 1 Mbytes (default
	  block size 128K).  SquashFS 4.0 supports 64 bit filesystems and files
	  (larger than 4GB), full uid/gid information, hard links and
	  timestamps.  

	  Squashfs is intended for general read-only filesystem use, for
	  archival use (i.e. in cases where a .tar.gz file may be used), and in
	  embedded systems where low overhead is needed.  Further information
	  and tools are available from http://squashfs.sourceforge.net.

	  If you want to compile this as a module ( = code which can be
	  inserted in and removed from the running kernel whenever you want),
	  say M here and read <file:Documentation/modules.txt>.  The module
	  will be called squashfs.  Note that the root file system (the one
	  containing the directory /) cannot be compiled as a module.

	  If unsure, say N.

config SQUASHFS_EMBEDDED

	bool "Additional option for memory-constrained systems" 
	depends on SQUASHFS
	default n
	help
	  Saying Y here allows you to specify cache size.

	  If unsure, say N.

config SQUASHFS_FRAGMENT_CACHE_SIZE
	int "Number of fragments cached" if SQUASHFS_EMBEDDED
	depends on SQUASHFS
	default "3"
	help
	  By default SquashFS caches the last 3 fragments read from
	  the filesystem.  Increasing this amount may mean SquashFS
	  has to re-read fragments less often from disk, at the expense
	  of extra system memory.  Decreasing this amount will mean
	  SquashFS uses less memory at the expense of extra reads from disk.

	  Note there must be at least one cached fragment.  Anything
	  much more than three will probably not make much difference.

config SQUASHFS_LINEAR
	bool "Use linear addressing for SquashFS"
	depends on SQUASHFS
	help
	  This option tells the SquashFS driver to load data directly from
	  a linear adressed memory range (usually non volatile memory
	  like flash) instead of going through the block device layer.
	  This saves some memory since no intermediate buffering is
	  necessary.

	  The location of the SquashFs image in memory is board
	  dependent. Therefore, if you say Y, you must know the proper
	  physical address where to store the SquashFS image and specify
	  it using the physaddr=0x******** mount option (for example:
	  "mount -t squashfs_linear -o physaddr=0x100000 none /mnt").

	  If unsure, say N.

config ROOT_SQUASHFS_LINEAR
	bool "Root file system on linear SquashFS"
	depends on SQUASHFS_LINEAR
	help
	  Say Y if you have enabled linear SquashFS, and you want to be
	  able to use the linear SquashFS image as a root file system.  To
	  actually have the kernel mount this SquashFS image as a root
	  file system, you must also pass the command line parameter
	  "root=/dev/null rootflags=physaddr=0x********" to the kernel
	  (replace 0x******** with the physical address location of the
	  linear SquashFS image to boot with).

config SQUASHFS_USE_IOREMAP_MEM_CACHED
	bool "Use ioremap_mem_nocache to map memory"
	depends on SQUASHFS_LINEAR && ARM
```
